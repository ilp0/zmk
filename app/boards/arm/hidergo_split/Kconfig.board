## app/boards/arm/hidergo_split/Kconfig.board
```kconfig
# nice!nano board configuration

# Copyright (c) 2020 Pete Johanson
# SPDX-License-Identifier: MIT

config BOARD_HIDERGO_SPLIT
	bool "hidergo_split"
	depends on SOC_NRF52833_QIAA
```

## app/boards/arm/hidergo_split/Kconfig.defconfig
```kconfig
# Copyright (c) 2021 The ZMK Contributors
# SPDX-License-Identifier: MIT

if BOARD_HIDERGO_SPLIT

config BOARD
	default "hidergo_split"

config USB_NRFX
	default y

# Enable UART driver, needed for CDC ACM
config USB_CDC_ACM
	default y

config BT_CTLR
	default BT

config ZMK_BLE
	default y

config ZMK_USB
	default y

endif # BOARD_HIDERGO_SPLIT
```

## app/boards/arm/hidergo_split/hidergo_split_left_defconfig
```kconfig
# SPDX-License-Identifier: MIT
CONFIG_SOC_SERIES_NRF52X=y
CONFIG_SOC_NRF52833_QIAA=y

# Enable MPU
#CONFIG_ARM_MPU=y
CONFIG_USE_DT_CODE_PARTITION=y
CONFIG_BOARD_HIDERGO_SPLIT_LEFT=y
CONFIG_ZMK_SPLIT=y
CONFIG_ZMK_SPLIT_BLE_ROLE_CENTRAL=y
#CONFIG_ZMK_DISPLAY=y
#CONFIG_ZMK_MOUSE=y
#CONFIG_IQS5XX=y
#IQS5XX_TRIGGER_OWN_THREAD=y
#CONFIG_IQS5XX_THREAD_PRIORITY=100
# enable GPIO
CONFIG_GPIO=y

# Enable I2C
#CONFIG_I2C=y
#CONFIG_I2C_NRFX=y
#CONFIG_I2C_0=y

# Enable SPI
#CONFIG_SPI=y
#CONFIG_SPI_2=y
#CONFIG_SPI_NRFX=y

# Enable writing to flash
CONFIG_MPU_ALLOW_FLASH_WRITE=y
CONFIG_NVS=y
CONFIG_SETTINGS_NVS=y
CONFIG_FLASH=y
CONFIG_FLASH_PAGE_LAYOUT=y
CONFIG_FLASH_MAP=y

# Enable 32kHz crystal
#CONFIG_CLOCK_CONTROL_NRF_K32SRC_XTAL=y
#CONFIG_CLOCK_CONTROL_NRF_K32SRC_30PPM=y

# enable display drivers
#CONFIG_SSD1306=n
#CONFIG_IL0323=y
#CONFIG_LVGL_HOR_RES_MAX=80
#CONFIG_LVGL_VER_RES_MAX=128
#CONFIG_LVGL_BITS_PER_PIXEL=1
#CONFIG_LVGL_COLOR_DEPTH_1=y
#CONFIG_LVGL_DPI=145
#CONFIG_LVGL_VDB_SIZE=100
#CONFIG_LVGL_USE_THEME_MONO=y
#CONFIG_LVGL_THEME_DEFAULT_COLOR_PRIMARY_RED=n
#CONFIG_LVGL_THEME_DEFAULT_COLOR_SECONDARY_RED=n
#CONFIG_LVGL_THEME_DEFAULT_COLOR_PRIMARY_BLACK=y
#CONFIG_LVGL_THEME_DEFAULT_COLOR_SECONDARY_WHITE=y
#CONFIG_LVGL_THEME_DEFAULT_FONT_SMALL_MONTSERRAT_16=y
#CONFIG_LVGL_THEME_DEFAULT_FONT_NORMAL_MONTSERRAT_26=y

# Turn on logging, and set ZMK logging to debug output
CONFIG_LOG=y
CONFIG_ZMK_USB_LOGGING=y
CONFIG_ZMK_LOG_LEVEL_DBG=y
CONFIG_LOG_BUFFER_SIZE=10000
#CONFIG_LOG_STRDUP_BUF_COUNT=60
#CONFIG_I2C_LOG_LEVEL_DBG=y
#CONFIG_SPI_LOG_LEVEL_DBG=y
#CONFIG_DISPLAY_LOG_LEVEL_DBG=y
#CONFIG_LVGL_LOG_LEVEL_DBG=y
#CONFIG_LVGL_USE_DEBUG=y
#CONFIG_SENSOR_LOG_LEVEL_DBG=y
#CONFIG_ZMK_BATTERY_NRF_VDDH=y

# Turn on USB CDC ACM device
CONFIG_USB=y
CONFIG_USB_DEVICE_STACK=y
CONFIG_USB_CDC_ACM=y
CONFIG_USB_CDC_ACM_RINGBUF_SIZE=1024
CONFIG_USB_CDC_ACM_DEVICE_NAME="CDC_ACM_0"
CONFIG_USB_CDC_ACM_DEVICE_COUNT=1

# Enable serial console
CONFIG_SERIAL=y
CONFIG_CONSOLE=y
CONFIG_UART_INTERRUPT_DRIVEN=y
CONFIG_UART_LINE_CTRL=y

# Enable USB UART, and set the console device
CONFIG_UART_CONSOLE=y
CONFIG_USB_UART_CONSOLE=y
CONFIG_UART_CONSOLE_ON_DEV_NAME="CDC_ACM_0"

#CONFIG_CLOCK_CONTROL_NRF=y
##CONFIG_CLOCK_CONTROL_NRF_K32SRC_RC=y
```

## app/boards/arm/hidergo_split/hidergo_split_right_defconfig
```kconfig
# SPDX-License-Identifier: MIT

CONFIG_SOC_SERIES_NRF52X=y
CONFIG_SOC_NRF52833_QIAA=y
CONFIG_BOARD_HIDERGO_SPLIT=y


# Enable MPU
CONFIG_ARM_MPU=y

# enable GPIO
CONFIG_GPIO=y

# enable i2c
CONFIG_I2C=y

# IQS5XX
CONFIG_IQS5XX=y
CONFIG_IQS5XX_THREAD_PRIORITY=100

CONFIG_USE_DT_CODE_PARTITION=y
CONFIG_BUILD_OUTPUT_UF2=y

CONFIG_ZMK_SPLIT=y
CONFIG_ZMK_SPLIT_BLE_ROLE_CENTRAL=y

CONFIG_MPU_ALLOW_FLASH_WRITE=y
CONFIG_NVS=y
CONFIG_SETTINGS_NVS=y
CONFIG_FLASH=y
CONFIG_FLASH_PAGE_LAYOUT=y
CONFIG_FLASH_MAP=y

# USB
CONFIG_USB_DEVICE_VID=0x1D55
CONFIG_USB_DEVICE_PID=0x6163
CONFIG_ZMK_USB=y
CONFIG_ZMK_USB_LOGGING=y
CONFIG_USB_DEVICE_MANUFACTURER="hid:ergo"
CONFIG_USB_DEVICE_PRODUCT="split"
```

## app/boards/shields/bonzo/Kconfig.defconfig
```kconfig
# Copyright (c) 2020 The ZMK Contributors
# SPDX-License-Identifier: MIT

if SHIELD_BONZO

config ZMK_KEYBOARD_NAME
    default "Bonzo"

endif
```

## app/boards/shields/bonzo/Kconfig.shield
```kconfig
# Copyright (c) 2020 The ZMK Contributors
# SPDX-License-Identifier: MIT

config SHIELD_BONZO
    def_bool $(shields_list_contains,bonzo)
```

## app/boards/shields/disconnect72/Kconfig.defconfig
```kconfig
if SHIELD_DISCONNECT72_RIGHT

config ZMK_KEYBOARD_NAME    
    default "d72zmk"

config ZMK_SPLIT_BLE_ROLE_CENTRAL    
    default y

endif

if SHIELD_DISCONNECT72_LEFT || SHIELD_DISCONNECT72_RIGHT

config ZMK_SPLIT    
    default y
    
endif

if ZMK_DISPLAY

config I2C
	default y

config SSD1306
	default y

config SSD1306_REVERSE_MODE
	default y

endif # ZMK_DISPLAY
```

## app/boards/shields/disconnect72/Kconfig.shield
```kconfig
config SHIELD_DISCONNECT72
    bool

config SHIELD_DISCONNECT72_LEFT
    def_bool $(shields_list_contains,disconnect72_left)
    select SHIELD_DISCONNECT72
    
config SHIELD_DISCONNECT72_RIGHT
    def_bool $(shields_list_contains,disconnect72_right)
    select SHIELD_DISCONNECT72
```

## app/drivers/mouse_sensor/Kconfig
```kconfig
# Copyright (c) 2020 The ZMK Contributors
# SPDX-License-Identifier: MIT

menuconfig MOUSE_SENSOR
	bool "Handler for Mouse Sensors"
	help
	  Enable driver for mouse and trackball sensors. 
```

## app/drivers/sensor/azoteq_iqs5xx/Kconfig
```kconfig
# Copyright (c) 2022 The ZMK Contributors
# SPDX-License-Identifier: MIT

menuconfig IQS5XX
	bool "IQS5XX Trackpad IC"
	depends on GPIO
	depends on I2C
	help
	  Enable driver for IQS5XX based-trackpads

if IQS5XX

choice
	prompt "Trigger mode"
	default IQS5XX_TRIGGER_NONE
	help
	  Specify the type of triggering to be used by the driver.

config IQS5XX_TRIGGER_NONE
	bool "No trigger"

config IQS5XX_TRIGGER_GLOBAL_THREAD
	bool "Use global thread"
	depends on GPIO
	select IQS5XX_TRIGGER

config IQS5XX_TRIGGER_OWN_THREAD
	bool "Use own thread"
	depends on GPIO
	select IQS5XX_TRIGGER

endchoice

config IQS5XX_TRIGGER
	bool

config IQS5XX_THREAD_PRIORITY
	int "Thread priority"
	depends on IQS5XX_TRIGGER_OWN_THREAD
	default 10
	help
	  Priority of thread used by the driver to handle interrupts.

config IQS5XX_THREAD_STACK_SIZE
	int "Thread stack size"
	depends on IQS5XX_TRIGGER_OWN_THREAD
	default 1024
	help
	  Stack size of thread used by the driver to handle interrupts.

endif # IQS5XX
```

## app/drivers/zephyr/dts/bindings/sensor/azoteq,iqs5xx.yaml
```yaml
description: |
  Sensor driver for the Azoteq IQS5XX trackpad IC
compatible: "azoteq,iqs5xx"

include: base.yaml

properties:
  label:
    type: string
    required: true

  dr-gpios:
    type: phandle-array
    required: true
    description: Data ready pin for the trackpad

  invert-x:
    type: boolean
    
  invert-y:
    type: boolean
```

## app/dts/bindings/zmk,mouse-sensor.yaml
```yaml
# Copyright (c) 2020, Pete Johanson
# SPDX-License-Identifier: MIT

description: Mouse sensor driver

compatible: "zmk,mouse-sensor"

properties:
  sensor:
    type: phandle
    required: true
```

## zmk-config/west.yml
```yaml
manifest:
  remotes:
    - name: ilp0
      url-base: https://github.com/ilp0
    # Additional modules containing boards/shields/custom code can be listed here as well
    # See https://docs.zephyrproject.org/3.2.0/develop/west/manifest.html#projects
  projects:
    - name: zmk
      remote: zmkfirmware
      revision: main
      import: app/west.yml
  self:
    path: config
```
